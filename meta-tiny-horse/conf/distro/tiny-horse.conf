## meta-tiny-horse/conf/distro/tiny-horse.conf
```bitbake
require conf/distro/poky.conf

DISTRO = "tiny-horse"
DISTRO_NAME = "Tiny Horse"
DISTRO_VERSION = "1.0"
DISTRO_CODENAME = "tinyhorse"
DISTROOVERRIDES = "poky:poky-tiny"
TCLIBC = "musl"

FULL_OPTIMIZATION="-Os -pipe ${DEBUG_FLAGS}"

MAINTAINER = "tiny-horse <tiny-horse@example.com>"

# Trim the feature set for a smaller, console-only system.
DISTRO_FEATURES:remove = "x11 wayland opengl vulkan ptest"

# Smaller package format than rpm.
PACKAGE_CLASSES = "package_ipk"
```

## meta-tiny-horse/conf/layer.conf
```bitbake
BBPATH .= ":${LAYERDIR}"

BBFILES += "${LAYERDIR}/recipes-*/*/*.bb \
            ${LAYERDIR}/recipes-*/*/*.bbappend"

BBFILE_COLLECTIONS += "tiny-horse"
BBFILE_PATTERN_tiny-horse = "^${LAYERDIR}/"
BBFILE_PRIORITY_tiny-horse = "6"

LAYERDEPENDS_tiny-horse = "core"
LAYERSERIES_COMPAT_tiny-horse = "scarthgap"
```
